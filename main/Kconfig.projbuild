## main/Kconfig.projbuild
```kconfig
menu "Example Configuration"

config BLINK_GPIO
    int "Blink GPIO number"
	range 0 34
	default 5
	help
		GPIO number (IOxx) to blink on and off.

		Some GPIOs are used for other purposes (flash connections, etc.) and cannot be used to blink.

		GPIOs 35-39 are input-only so cannot be used as outputs.

endmenu

menu "ESP32 Camera Demo Configuration"

choice ESP_WIFI_MODE
    prompt "AP or STA"
    default ESP_WIFI_IS_SOFTAP
    help
        Whether the esp32 is softAP or station.

config ESP_WIFI_IS_SOFTAP
    bool "SoftAP"
config ESP_WIFI_IS_STATION
    bool "Station"
endchoice

config ESP_WIFI_MODE_AP
    bool
    default y if ESP_WIFI_IS_SOFTAP
    default n if ESP_WIFI_IS_STATION

config ESP_WIFI_SSID
    string "WiFi SSID"
    default "M5Cam"
    help
	SSID (network name) for the example to connect to.

config ESP_WIFI_PASSWORD
    string "WiFi Password"
    default ""
    help
	WiFi password (WPA or WPA2) for the example to use.

endmenu
```
